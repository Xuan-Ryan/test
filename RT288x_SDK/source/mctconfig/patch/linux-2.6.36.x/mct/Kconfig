## RT288x_SDK/source/mctconfig/patch/linux-2.6.36.x/mct/Kconfig
```kconfig
menu "MCT Related"

#######
# UVC Type
#######
choice
prompt "UVC TYPE"
	
config  MCT_RX
bool "RX"
config  MCT_TX
bool "TX"
endchoice


endmenu
```
